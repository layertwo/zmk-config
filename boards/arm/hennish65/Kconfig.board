## boards/arm/hennish65/Kconfig.board
```kconfig
# Copyright (c) 2020-2021 Thys de Wet (vattern)
# SPDX-License-Identifier: MIT



config BOARD_HENNISH65
	bool "hennish65"
	depends on SOC_NRF52840_QIAA
```

## config/boards/shields/sodium62/Kconfig.defconfig
```kconfig
# Copyright (c) 2022 Derek Schmell
# SPDX-License-Identifier: MIT
 
 
if SHIELD_SODIUM62_LEFT

config ZMK_KEYBOARD_NAME
	default "sodium62"

config ZMK_SPLIT_BLE_ROLE_CENTRAL
	default y

endif

if SHIELD_SODIUM62_LEFT || SHIELD_SODIUM62_RIGHT

config ZMK_SPLIT
	default y
	
endif
```

## config/boards/shields/sodium62/Kconfig.shield
```kconfig
# Copyright (c) 2022 Derek Schmell
# SPDX-License-Identifier: MIT

config SHIELD_SODIUM62_LEFT
	def_bool $(shields_list_contains,sodium62_left)

config SHIELD_SODIUM62_RIGHT
	def_bool $(shields_list_contains,sodium62_right)
```
