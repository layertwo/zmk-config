/*
 * Copyright (c) 2020 Derek Schmell
 *
 * SPDX-License-Identifier: MIT
 */

#include "sodium62.dtsi"

&kscan0 {
	col-gpios
		= <&pro_micro  0 GPIO_ACTIVE_HIGH>
		, <&pro_micro  5 GPIO_ACTIVE_HIGH>
		, <&pro_micro  7 GPIO_ACTIVE_HIGH>
		, <&pro_micro 9 GPIO_ACTIVE_HIGH>
		, <&pro_micro 16 GPIO_ACTIVE_HIGH>
		, <&pro_micro 14 GPIO_ACTIVE_HIGH>
		, <&pro_micro 15 GPIO_ACTIVE_HIGH>
		;
};

