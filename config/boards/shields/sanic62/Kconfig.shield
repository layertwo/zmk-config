## config/boards/shields/sanic62/Kconfig.shield
```kconfig
# Copyright (c) 2022 Derek Schmell, Lucas Messenger
# SPDX-License-Identifier: MIT

config SHIELD_SANIC62_LEFT
	def_bool $(shields_list_contains,sanic62_left)

config SHIELD_SANIC62_RIGHT
	def_bool $(shields_list_contains,sanic62_right)
```

## config/shields/sanic62/Kconfig.defconfig
```kconfig
# Copyright (c) 2022 Derek Schmell
# SPDX-License-Identifier: MIT
 
 
if SHIELD_SPLITREUS62_LEFT

config ZMK_KEYBOARD_NAME
	default "sanic62"

config ZMK_SPLIT_BLE_ROLE_CENTRAL
	default y

endif

if SHIELD_SANIC62_LEFT || SHIELD_SANIC62_RIGHT

config ZMK_SPLIT
	default y
	
endif
```

## config/shields/sanic62/Kconfig.shield
```kconfig
# Copyright (c) 2022 Derek Schmell
# SPDX-License-Identifier: MIT

config SHIELD_SPLITREUS62_LEFT
	def_bool $(shields_list_contains,sanic62_left)

config SHIELD_SPLITREUS62_RIGHT
	def_bool $(shields_list_contains,sanic62_right)
```

## config/west.yml
```yaml
manifest:
  defaults:
    revision: v0.3
  remotes:
    - name: zmkfirmware
      url-base: https://github.com/zmkfirmware
    - name: Na-Cly
      url-base: https://github.com/Na-Cly
  projects:
    - name: zmk
      remote: zmkfirmware
      import: app/west.yml
    - name: zmk-keyboard-hennish65
      remote: Na-Cly
      revision: main
  self:
    path: config
```
